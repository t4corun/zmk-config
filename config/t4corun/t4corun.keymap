#include <behaviors.dtsi>
#include <behaviors/num_word.dtsi>
#include <behaviors/rgbled_widget.dtsi>
#include <dt-bindings/zmk/keys.h>
#include <dt-bindings/zmk/bt.h>
#include <dt-bindings/zmk/outputs.h>
#include <dt-bindings/zmk/pointing.h>

#include "t4corun.h"
#include "combos.dtsi"

/ {
    behaviors {
        HRM_MACRO(hrmlshft,  HRM_TAPPING_TERM,     KEYS_R HRM_SHFT)
        HRM_MACRO(hrmlctrl,  HRM_TAPPING_TERM,     KEYS_R HRM_LCTRL)
        HRM_MACRO(hrmlalt,   HRM_TAPPING_TERM,     HRM_NONE)
        HRM_MACRO(hrmright,  HRM_TAPPING_TERM,     KEYS_L)
        HRM_MACRO(hrmralt,   HRM_TAPPING_TERM,     HRM_RALT)
        HRM_MACRO(hrmgui,    HRM_TAPPING_TERM,     HRM_GUI)

        MOD_MORPH(ko_com,    &kp COMMA, &kp QMARK, MOD_LSFT)
        MOD_MORPH(ko_dot,    &kp DOT,   &kp EXCL,  MOD_LSFT)
        MOD_MORPH(ko_gcom,   &kp COMMA, &kp EXCL,  MOD_LSFT)
        MOD_MORPH(ko_gdot,   &kp DOT,   &kp QMARK, MOD_LSFT)
        MOD_MORPH(ko_bpsc,   &kp BSPC,  &kp DEL,   MOD_LSFT)
    };

    conditional_layers {
        compatible = "zmk,conditional-layers";
        tri_layer {
            if-layers = <_NUMBER _NAVIGATION>;
            then-layer = <_SYMBOL>;
        };
    };

    symbols {
        MACRO(        mc_brc,  &kp LBRC  &kp RBRC   &kp LEFT)
        HOLDTAP_MACRO(ht_brc,  &mc_brc)

        MACRO(        mc_lgt,  &kp LT    &kp GT     &kp LEFT)
        HOLDTAP_MACRO(ht_lgt,  &mc_lgt)

        MACRO(        mc_bkt,  &kp LBKT  &kp RBKT   &kp LEFT)
        HOLDTAP_MACRO(ht_bkt,  &mc_bkt)

        MACRO(        mc_par,  &kp LPAR  &kp RPAR   &kp LEFT)
        HOLDTAP_MACRO(ht_par,  &mc_par)

        MACRO(        mc_squo, &kp SQT    &kp SQT   &kp LEFT)
        HOLDTAP_MACRO(ht_sqt,  &mc_squo)

        MACRO(        mc_dquo, &kp DQT    &kp DQT   &kp LEFT)
        HOLDTAP_MACRO(ht_dqt,  &mc_dquo)
    };
};


&lt {
	tapping-term-ms = <150>;
};