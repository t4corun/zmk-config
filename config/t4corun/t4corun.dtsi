#include <behaviors.dtsi>
#include <dt-bindings/zmk/keys.h>
#include <dt-bindings/zmk/bt.h>
#include <dt-bindings/zmk/outputs.h>

/ {
    behaviors {
    };
};

&lt {
    flavor = "tap-preferred";
    tapping-term-ms = <TAPPING_TERM>;
};

&mt {
    flavor = "tap-preferred";
    tapping-term-ms = <TAPPING_TERM>;
};