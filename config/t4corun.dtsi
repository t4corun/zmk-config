#include <behaviors.dtsi>
#include <dt-bindings/zmk/keys.h>
#include <dt-bindings/zmk/bt.h>
#include <dt-bindings/zmk/outputs.h>

#include "include/t4corun.h"

/ {
    behaviors {
    };
};

&lt {
    flavor = "tap-preferred";
    tapping-term-ms = <TAPPING_TERM>; // this works because ZMK processes C before devicetree files
};

&mt {
    flavor = "tap-preferred";
    tapping-term-ms = <TAPPING_TERM>;
};