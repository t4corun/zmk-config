#include <behaviors.dtsi>
#include <dt-bindings/zmk/keys.h>
#include <dt-bindings/zmk/bt.h>
#include <dt-bindings/zmk/outputs.h>
#include <dt-bindings/zmk/mouse.h>

#define ZMK_HELPER_STRINGIFY(x) #x

#define ZMK_HOLDTAP_CORE		          flavor = "tap-preferred"; tapping-term-ms = <TAPPING_TERM>; quick-tap-ms = <QUICK_TAP_TERM>;
#define ZMK_MACRO_CORE			          wait-ms = <MACRO_WAIT_TERM>; tap-ms = <MACRO_TAP_TERM>;

//#define ZMK_BEHAVIOR_CORE_caps_word       compatible = "zmk,behavior-caps-word";       #binding-cells = <0>
#define ZMK_BEHAVIOR_CORE_hold_tap        compatible = "zmk,behavior-hold-tap";        #binding-cells = <2>
#define ZMK_BEHAVIOR_CORE_macro           compatible = "zmk,behavior-macro";           #binding-cells = <0>
//#define ZMK_BEHAVIOR_CORE_macro_one_param compatible = "zmk,behavior-macro-one-param"; #binding-cells = <1>
//#define ZMK_BEHAVIOR_CORE_macro_two_param compatible = "zmk,behavior-macro-two-param"; #binding-cells = <2>
//#define ZMK_BEHAVIOR_CORE_sticky_key      compatible = "zmk,behavior-sticky-key";      #binding-cells = <1>
#define ZMK_BEHAVIOR_CORE_tap_dance       compatible = "zmk,behavior-tap-dance";       #binding-cells = <0>
//#define ZMK_BEHAVIOR_CORE_tri_state       compatible = "zmk,behavior-tri-state";       #binding-cells = <0>
//#define ZMK_BEHAVIOR_CORE_dynamic_macro   compatible = "zmk,behavior-dynamic-macro";   #binding-cells = <1>
//#define ZMK_BEHAVIOR_CORE_mod_morph       compatible = "zmk,behavior-mod-morph";       #binding-cells = <0>
//#define ZMK_BEHAVIOR_CORE_key_repeat      compatible = "zmk,behavior-key-repeat";      #binding-cells = <0>

#define ZMK_BEHAVIOR(NAME, TYPE, ...) 				\
    NAME: NAME { 									\
        label = ZMK_HELPER_STRINGIFY(TR_ ## NAME); 	\
        ZMK_BEHAVIOR_CORE_ ## TYPE; 				\
        __VA_ARGS__									\
    };

// Layer Definitions out toggle
#define QWERTY  0
#define COLEMAK 1
#define NUMBER  2
#define NAVI    3
#define SYMBOL  4
#define MOUSE	5
#define CONFIG  6

// Feature Configuration: Tapping
#define TAPPING_TERM 	200
#define MOUSE_TAP_TERM	170
#define NAV_TAP_TERM	125
#define QUICK_TAP_TERM 	100

// Feature Configuration: Combos
#define COMBO_TIMEOUT 50

// Feature Configuration: Sicky Keys
#define STICKYKEY_TIMEOUT 	2000

// Feature Configuration: Macros
#define MACRO_TAP_TERM 10
#define MACRO_WAIT_TERM 10

// Feature Configuration: Mouse (beta)
#define U_MOUSE_MOVE_DELAY 0
#define U_MOUSE_MOVE_EXPONENT 1
#define U_MOUSE_MOVE_TIME 750
#define U_MOUSE_SCROLL_DELAY 0
#define U_MOUSE_SCROLL_EXPONENT 1
#define U_MOUSE_SCROLL_TIME 0

// Custom layer taps
#define MOU(keycode)	&mou MOUSE 	keycode
#define NAV(keycode)	&nav NAVI 	keycode

// Switch base layer
#define DEFAULT		&to QWERTY
#define CLMAKDH 	&to	COLEMAK

// Windows Shortcuts
#define W_UNDO  	&kp LC(Z)
#define W_CUT   	&kp LC(X)
#define W_COPY  	&kp LC(C)
#define W_PASTE 	&kp LC(V)
#define W_REDO  	&kp LC(Y)
#define W_SNIP  	&kp LS(LG(S))
#define W_FILE  	&kp LG(E)
#define NEXTTAB 	&kp LC(TAB)

// Bluetooth
#define BTClear 	&bt BT_CLR
#define BT0     	&bt BT_SEL 0
#define BT1     	&bt BT_SEL 1
#define BT2     	&bt BT_SEL 2
#define BT3     	&bt BT_SEL 3
#define BT4     	&bt BT_SEL 4

// Hold Taps. Tap for one key, hold to get another
#define HT(holdkey, tapkey)		&ht 	holdkey	tapkey

/*
2023-08-24 
The below is temporary because Nick Conway started his dev branch before main zmk released parameterized macros

#TODO remove this in the future
*/

// hold to insert preprogrammed brackets/quotes with the cursor inside or tap for specified key
#define fBRC(tapkey)	&ht_brc 0 tapkey
#define fLGT(tapkey)	&ht_lgt 0 tapkey
#define fBKT(tapkey)	&ht_bkt 0 tapkey
#define fPAR(tapkey)	&ht_par 0 tapkey
#define fSQT(tapkey)	&ht_sqt 0 tapkey
#define fDQT(tapkey)	&ht_dqt 0 tapkey


// hold to double tap a preprogrammed key, tap for specified key
#define fBSLH(tapkey) 	&ht_bslh 0 tapkey
#define fFSLH(tapkey) 	&ht_fslh 0 tapkey
#define fUND(tapkey) 	&ht_und 0 tapkey
#define fPIPE(tapkey) 	&ht_pipe 0 tapkey
#define fHASH(tapkey) 	&ht_hash 0 tapkey
#define fEQL(tapkey) 	&ht_eql 0 tapkey
#define fAMP(tapkey) 	&ht_amp 0 tapkey

// hold for custom macro, tap for specified key
#define fNEQL(tapkey) 	&ht_neql 0 tapkey
#define fGRV(tapkey) 	&ht_grv 0 tapkey


// customizaiton of stock ZMK features
&sk {
    release-after-ms = <STICKYKEY_TIMEOUT>;
    quick-release;
};

&caps_word {
    continue-list = <UNDER MINUS BSPC DEL>;
};

&mmv {
    delay-ms = <U_MOUSE_MOVE_DELAY>;
    acceleration-exponent = <U_MOUSE_MOVE_EXPONENT>;
    time-to-max-speed-ms = <U_MOUSE_MOVE_TIME>;
};

&mwh {
    delay-ms = <U_MOUSE_SCROLL_DELAY>;
    acceleration-exponent = <U_MOUSE_SCROLL_EXPONENT>;
    time-to-max-speed-ms = <U_MOUSE_SCROLL_TIME>;
};