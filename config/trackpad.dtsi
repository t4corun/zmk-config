/ {
    trackpad_behaviors {
        swipe_button_mapper: swipe_button_mapper {
            compatible = "zmk,input-processor-behaviors";
            #input-processor-cells = <0>;
            codes = <INPUT_BTN_NORTH INPUT_BTN_EAST INPUT_BTN_SOUTH INPUT_BTN_WEST>;
            bindings = <&kp LG(TAB)>, <&kp LG(RIGHT)>, <&kp LG(D)>, <&kp LG(LEFT)>;
        };
    };

    trackpad_listener {
        input-processors =  <&swipe_button_mapper>,
                            <&zip_xy_scaler 1 1>,
                            <&zip_scroll_scaler 1 20>;
    };
};
