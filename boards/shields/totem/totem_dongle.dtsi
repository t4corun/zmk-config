/*
 * Copyright (c) 2026 Victor Nguyen
 *
 * SPDX-License-Identifier: MIT
 */

#include "totem.dtsi"

/ {

    chosen {
        zmk,kscan = &mock_kscan;
        zmk,physical-layout = &physical_layout;
    };

    mock_kscan: dongle_kscan {
        compatible = "zmk,kscan-mock";
        columns = <0>;
        rows = <0>;
        events = <0>;
    };

    // delete this because the dongle does
    // not need matrix gpio pins defined
    /delete-node/ seed_xiao_kscan;
};

&physical_layout {
    kscan = <&mock_kscan>;
};
