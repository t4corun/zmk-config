/*
 * Copyright (c) 2026 Victor Nguyen
 *
 * SPDX-License-Identifier: MIT
 */

#include "dongle.dtsi"
#include "trackpad.dtsi"

&trackpad_split {
    status = "okay";
};

&trackpad_listener {
    status = "okay";
};
