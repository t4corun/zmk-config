## boards/shields/temporal/Kconfig.shield
```kconfig
# Copyright (c) 2024 Curtis Bollinger
# SPDX-License-Identifier: MIT

config SHIELD_TEMPORAL_LEFT
    def_bool \
        $(shields_list_contains,temporal_dongleleft) || \
        $(shields_list_contains,temporal_prospectorleft)

config SHIELD_TEMPORAL_RIGHT
    def_bool \
        $(shields_list_contains,temporal_dongleright) || \
        $(shields_list_contains,temporal_prospectorright)

config SHIELD_TEMPORAL_DONGLE
    def_bool \
        $(shields_list_contains,temporal_dongle) || \
        $(shields_list_contains,temporal_prospector)
```

## boards/shields/totem/Kconfig.shield
```kconfig
# Copyright (c) 2026 Victor Nguyen
# SPDX-License-Identifier: MIT

config SHIELD_TOTEM_LEFT
    def_bool $(shields_list_contains,totem_left)

config SHIELD_TOTEM_RIGHT
    def_bool $(shields_list_contains,totem_right)

config SHIELD_TOTEM_DONGLE
    def_bool \
        $(shields_list_contains,totem_prospector) || \
        $(shields_list_contains,totem_rgbdongle)
```

## config/west.yml
```yaml
manifest:
  remotes:
    - name: zmkfirmware
      url-base: https://github.com/zmkfirmware
    - name: carrefinho
      url-base: https://github.com/carrefinho
    - name: urob
      url-base: https://github.com/urob
    - name: caksoylar
      url-base: https://github.com/caksoylar
    - name: geeksville
      url-base: https://github.com/geeksville
    - name: dmhuisma
      url-base: https://github.com/dmhuisma
    - name: t4corun
      url-base: https://github.com/t4corun
  projects:
    - name: zmk
      remote: zmkfirmware
      revision: main
      import: app/west.yml
    - name: prospector-zmk-module
      remote: carrefinho
      revision: feat/new-status-screens
    - name: zmk-rgbled-widget
      remote: caksoylar
      revision: main
    - name: zmk-auto-layer
      remote: urob
      revision: main
    - name: zmk_driver_azoteq
      remote: geeksville
      revision: master
    - name: nice-view-battery-peripheral
      remote: dmhuisma
      revision: zmk_0.4
    - name: zmk_arbitrary_split_data_channel
      remote: t4corun
      revision: bugfix
    - name: zmk-split-status-relay
      remote: dmhuisma
      revision: main
  self:
    path: config
```
