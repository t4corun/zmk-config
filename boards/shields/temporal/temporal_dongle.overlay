/*
 * Copyright (c) 2026 Victor Nguyen
 *
 * SPDX-License-Identifier: MIT
 */

#include "dongle.dtsi"
#include "splitdatarelay.dtsi"

&asdc0 {
    status = "okay";
};

&ssr0 {
    status = "okay";
};
