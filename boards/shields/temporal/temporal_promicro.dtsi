/*
 * Copyright (c) 2026 Victor Nguyen
 *
 * SPDX-License-Identifier: MIT
 */

/ {
    /*
     * pro micro row definition
     *   this file is required because we have different microcontrollers
     *   between the peripherals (nice!nano v2) and the dongle (seeed xiao)
     *
     *   the columns are defined in the peripheral overlay files
     */

    kscan0: kscan {
        compatible = "zmk,kscan-gpio-matrix";
        wakeup-source;

        diode-direction = "col2row";
        row-gpios
            = <&pro_micro 4 (GPIO_ACTIVE_HIGH | GPIO_PULL_DOWN)>  // row_top
            , <&pro_micro 5 (GPIO_ACTIVE_HIGH | GPIO_PULL_DOWN)>  // row_home
            , <&pro_micro 6 (GPIO_ACTIVE_HIGH | GPIO_PULL_DOWN)>  // row_bottom
            , <&pro_micro 7 (GPIO_ACTIVE_HIGH | GPIO_PULL_DOWN)>  // row_thumb
            ;
    };
};
